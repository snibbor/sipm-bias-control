## firmware/zephyr/boards/arm/sipm_bias_controller/Kconfig.board
```kconfig
# SPDX-License-Identifier: Apache-2.0
config BOARD_SIPM_BIAS_CONTROLLER
	bool "Applikate SiPM Bias Controller board"
	select SOC_SAMD21E18A
	select BOARD_EARLY_INIT_HOOK
```

## firmware/zephyr/boards/arm/sipm_bias_controller/Kconfig.defconfig
```kconfig
if BOARD_SIPM_BIAS_CONTROLLER

config BOARD
	default "sipm_bias_controller"

config SOC
	default "atmel_samd21"

endif
```

## firmware/zephyr/boards/arm/sipm_bias_controller/Kconfig.sipm_bias_controller
```kconfig
# SPDX-License-Identifier: Apache-2.0
source "boards/arm/sipm_bias_controller/Kconfig.board"
source "boards/arm/sipm_bias_controller/Kconfig.defconfig"
```

## firmware/zephyr/boards/arm/sipm_bias_controller/board.yml
```yaml
board:
  name: sipm_bias_controller
  vendor: applikate
  socs:
  - name: samd21e18a
```

## firmware/zephyr/boards/arm/sipm_bias_controller/sipm_bias_controller_defconfig
```kconfig
CONFIG_SOC_ATMEL_SAMD_XOSC32K=n
CONFIG_SOC_ATMEL_SAMD_XOSC32K_AS_MAIN=n
CONFIG_SOC_ATMEL_SAMD_OSC8M=y
CONFIG_SOC_ATMEL_SAMD_OSC8M_AS_MAIN=y

CONFIG_USB_DEVICE_STACK=y
CONFIG_USB_DEVICE_PRODUCT="SiPM Bias Controller"
CONFIG_USB_DEVICE_VID=0x1915
CONFIG_USB_DEVICE_PID=0x5311
CONFIG_USB_CDC_ACM=y

CONFIG_CONSOLE=y
CONFIG_UART_CONSOLE=y
CONFIG_UART_INTERRUPT_DRIVEN=y
CONFIG_SERIAL=y
```

## firmware/zephyr/sysbuild/mcuboot/boards/sipm_bias_controller.conf
```kconfig
# USB CDC-ACM serial recovery
CONFIG_MCUBOOT_SERIAL=y
CONFIG_BOOT_SERIAL_CDC_ACM=y
CONFIG_BOOT_SERIAL_ENTRANCE_GPIO=n
CONFIG_BOOT_SERIAL_NO_APPLICATION=y
CONFIG_BOOT_SERIAL_BOOT_MODE=y

# Retention subsystem for boot mode flag
CONFIG_RETAINED_MEM=y
CONFIG_RETENTION=y
CONFIG_RETENTION_BOOT_MODE=y

# MUST disable UART console when using CDC-ACM
CONFIG_UART_CONSOLE=n
CONFIG_CONSOLE=n

CONFIG_USB_DEVICE_STACK=y
CONFIG_USB_CDC_ACM=y
CONFIG_USB_DEVICE_MANUFACTURER="Applikate"
CONFIG_USB_DEVICE_PRODUCT="SiPM Bias Controller (DFU)"
CONFIG_USB_DEVICE_INITIALIZE_AT_BOOT=n

# Clock: internal OSC8M (no external crystal on the bias board)
CONFIG_SOC_ATMEL_SAMD_OSC8M=y
```
